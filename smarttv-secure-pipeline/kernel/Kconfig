## smarttv-secure-pipeline/kernel/Kconfig
```kconfig
menu "smarttv-secure-pipeline"
source "kernel/secure_video/Kconfig"
source "kernel/rdma_stub/Kconfig"
endmenu
```

## smarttv-secure-pipeline/kernel/rdma_stub/Kconfig
```kconfig
config RDMA_STUB_SCAFFOLD
    tristate "RDMA-style dma-buf memcpy via DMAengine (scaffold)"
    depends on DMA_ENGINE && DMA_SHARED_BUFFER
    help
      Demo RDMA-style copy using DMAengine between dma-buf buffers.
```

## smarttv-secure-pipeline/kernel/secure_video/Kconfig
```kconfig
config SVP_SCAFFOLD
    tristate "Secure Video Path (SVP) scaffold (DMA-HEAP)"
    depends on DMA_SHARED_BUFFER && DMA_HEAPS
    help
      Demo SVP driver that allocates from DMA-HEAP (secure heap) and exports dma-buf fds.
```
